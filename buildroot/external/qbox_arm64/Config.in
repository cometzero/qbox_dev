## buildroot/external/qbox_arm64/Config.in
```kconfig
menu "QBox ARM64 external options"

config BR2_PACKAGE_QBOX_ARM64_BOARD_MARKER
	bool "Install QBox A710 board marker"
	default y
	help
	  Installs a small /etc/profile.d marker so boot logs identify the
	  Buildroot image as the QBox Cortex-A710 M1 initramfs lane.

endmenu
```

## buildroot/external/qbox_arm64/configs/qbox_a710_soc_defconfig
```kconfig
BR2_aarch64=y
BR2_cortex_a710=y
BR2_PACKAGE_HOST_LINUX_HEADERS_CUSTOM_6_19=y
BR2_TOOLCHAIN_BUILDROOT=y
BR2_TARGET_GENERIC_HOSTNAME="qbox-a710"
BR2_TARGET_GENERIC_ISSUE="QBox A710 Buildroot"
BR2_TARGET_GENERIC_GETTY_PORT="ttyAMA0"
BR2_SYSTEM_DHCP=""
BR2_ROOTFS_DEVICE_TABLE="system/device_table.txt $(BR2_EXTERNAL_QBOX_ARM64_PATH)/board/qbox/a710_soc/device_table.txt"
BR2_ROOTFS_OVERLAY="$(BR2_EXTERNAL_QBOX_ARM64_PATH)/board/qbox/a710_soc/rootfs_overlay"
BR2_ROOTFS_POST_BUILD_SCRIPT="$(BR2_EXTERNAL_QBOX_ARM64_PATH)/board/qbox/a710_soc/post-build.sh"
BR2_ROOTFS_POST_IMAGE_SCRIPT="$(BR2_EXTERNAL_QBOX_ARM64_PATH)/board/qbox/a710_soc/post-image.sh"
BR2_ROOTFS_POST_IMAGE_SCRIPT_ARGS="$(BR2_EXTERNAL_QBOX_ARM64_PATH)/board/qbox/a710_soc/qbox_a710_soc.dts"
BR2_TARGET_ROOTFS_CPIO=y
# BR2_TARGET_ROOTFS_TAR is not set
BR2_PACKAGE_HOST_DTC=y
```

## configs/buildroot/external/apollo_qbox/Config.in
```kconfig
menu "QBox ARM64 external options"

source "$BR2_EXTERNAL_APOLLO_QBOX_PATH/package/iree-runtime/Config.in"

config BR2_PACKAGE_APOLLO_QBOX_BOARD_MARKER
	bool "Install Apollo QBox board marker"
	default y
	help
	  Installs a small /etc/profile.d marker so boot logs identify the
	  Buildroot image as the Apollo SoC / apollo-qbox initramfs lane.

endmenu
```

## configs/buildroot/external/apollo_qbox/configs/apollo_qbox_defconfig
```kconfig
BR2_aarch64=y
BR2_cortex_a710=y
BR2_PACKAGE_HOST_LINUX_HEADERS_CUSTOM_6_19=y
BR2_TOOLCHAIN_BUILDROOT=y
BR2_TOOLCHAIN_BUILDROOT_CXX=y
BR2_INSTALL_LIBSTDCPP=y
BR2_CCACHE=y
BR2_TARGET_GENERIC_HOSTNAME="apollo-qbox"
BR2_TARGET_GENERIC_ISSUE="Apollo QBox Buildroot"
BR2_TARGET_GENERIC_GETTY_PORT="ttyAMA0"
BR2_SYSTEM_DHCP="eth0"
BR2_ROOTFS_DEVICE_TABLE="system/device_table.txt $(BR2_EXTERNAL_APOLLO_QBOX_PATH)/board/apollo/apollo-qbox/device_table.txt"
BR2_ROOTFS_OVERLAY="$(BR2_EXTERNAL_APOLLO_QBOX_PATH)/board/apollo/apollo-qbox/rootfs_overlay"
BR2_ROOTFS_POST_BUILD_SCRIPT="$(BR2_EXTERNAL_APOLLO_QBOX_PATH)/board/apollo/apollo-qbox/post-build.sh"
BR2_ROOTFS_POST_IMAGE_SCRIPT="$(BR2_EXTERNAL_APOLLO_QBOX_PATH)/board/apollo/apollo-qbox/post-image.sh"
BR2_ROOTFS_POST_IMAGE_SCRIPT_ARGS="$(BR2_EXTERNAL_APOLLO_QBOX_PATH)/../../../linux/apollo_soc.dts"
BR2_TARGET_ROOTFS_CPIO=y
# BR2_TARGET_ROOTFS_TAR is not set
BR2_PACKAGE_HOST_DTC=y
BR2_PACKAGE_OPENSSH=y
BR2_PACKAGE_OPENSSH_SERVER=y
BR2_PACKAGE_OPENSSH_CLIENT=y
BR2_PACKAGE_IREE_RUNTIME=y
```

## configs/buildroot/external/apollo_qbox/package/iree-runtime/Config.in
```kconfig
config BR2_PACKAGE_IREE_RUNTIME
	bool "IREE runtime tools"
	depends on BR2_INSTALL_LIBSTDCPP
	depends on BR2_TOOLCHAIN_HAS_THREADS
	depends on BR2_TOOLCHAIN_GCC_AT_LEAST_8 # C++17
	help
	  Build a minimal IREE runtime from the repo-local sources/iree
	  checkout and install iree-run-module into the target rootfs.

	  The upstream IREE runtime build still enables only the local CPU
	  HAL drivers. The installed /usr/bin/iree-run-module is a QBox
	  wrapper: local CPU devices are forwarded to the source-built IREE
	  binary, while apollo-hexagon queries and dispatches are routed to
	  the repo-local Apollo registry frontend and dynamic HAL plugin.
	  This is transitional evidence, not an upstream IREE HAL driver.

comment "iree-runtime needs a C++17 toolchain with thread support"
	depends on !BR2_INSTALL_LIBSTDCPP || !BR2_TOOLCHAIN_HAS_THREADS || \
		!BR2_TOOLCHAIN_GCC_AT_LEAST_8
```
